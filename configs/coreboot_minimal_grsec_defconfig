## configs/coreboot_minimal_grsec_defconfig
```kconfig
BR2_x86_64=y
BR2_x86_corei7_avx=y
BR2_CCACHE=y
BR2_CCACHE_DIR="$(CONFIG_DIR)/ccache"
BR2_GLOBAL_PATCH_DIR="$(BR2_EXTERNAL)/board/coreboot/patches"
BR2_TOOLCHAIN_BUILDROOT_WCHAR=y
BR2_ENABLE_LOCALE_PURGE=y
BR2_ENABLE_LOCALE_WHITELIST="C"
BR2_TARGET_GENERIC_HOSTNAME="rescue"
BR2_TARGET_GENERIC_ISSUE="Welcome to Coreboot Rescue"
BR2_ROOTFS_USERS_TABLES="$(BR2_EXTERNAL)/board/coreboot/users-table"
BR2_ROOTFS_POST_BUILD_SCRIPT="$(BR2_EXTERNAL)/board/coreboot/post_build.sh"
BR2_LINUX_KERNEL=y
BR2_LINUX_KERNEL_SAME_AS_HEADERS=y
BR2_LINUX_KERNEL_PATCH="$(BR2_EXTERNAL)/board/coreboot/linux-grsec-patches"
BR2_LINUX_KERNEL_USE_CUSTOM_CONFIG=y
BR2_LINUX_KERNEL_CUSTOM_CONFIG_FILE="$(BR2_EXTERNAL)/board/coreboot/linux-4.1-grsec.config"
BR2_PACKAGE_BUSYBOX_CONFIG="$(BR2_EXTERNAL)/board/coreboot/busybox.config"
BR2_PACKAGE_XZ=y
BR2_PACKAGE_PAX_UTILS=y
BR2_PACKAGE_E2TOOLS=y
BR2_PACKAGE_CRYPTSETUP=y
BR2_PACKAGE_FLASHROM=y
BR2_PACKAGE_PARTED=y
BR2_PACKAGE_WIPE=y
BR2_PACKAGE_CCID=y
BR2_PACKAGE_HAVEGED=y
BR2_PACKAGE_CRDA=y
BR2_PACKAGE_DROPBEAR=y
BR2_PACKAGE_DROPBEAR_DISABLE_REVERSEDNS=y
BR2_PACKAGE_IW=y
BR2_PACKAGE_MACCHANGER=y
BR2_PACKAGE_NTP=y
# BR2_PACKAGE_NTP_NTPD is not set
BR2_PACKAGE_NTP_NTPDATE=y
BR2_PACKAGE_TCPDUMP=y
BR2_PACKAGE_WIRELESS_TOOLS=y
BR2_PACKAGE_WPA_SUPPLICANT=y
BR2_PACKAGE_WPA_SUPPLICANT_EAP=y
BR2_PACKAGE_WPA_SUPPLICANT_CLI=y
BR2_PACKAGE_WPA_SUPPLICANT_PASSPHRASE=y
BR2_PACKAGE_FILE=y
BR2_PACKAGE_GNUPG2=y
BR2_PACKAGE_GNUPG2_GPGV2=y
BR2_PACKAGE_PINENTRY=y
BR2_PACKAGE_PWGEN=y
BR2_TARGET_ROOTFS_CPIO=y
BR2_TARGET_ROOTFS_CPIO_XZ=y
# BR2_TARGET_ROOTFS_TAR is not set
BR2_PACKAGE_CBFSTOOL=y
BR2_PACKAGE_CBMEM=y
BR2_PACKAGE_IFDTOOL=y
BR2_PACKAGE_INTELMETOOL=y
BR2_PACKAGE_NVRAMTOOL=y
BR2_DEFCONFIG="$(BR2_EXTERNAL)/configs/coreboot_minimal_grsec_defconfig"
```

## package/Config.in
```kconfig
menu "Networking applications"
	source "$BR2_EXTERNAL/package/tlsdate/Config.in"
	source "$BR2_EXTERNAL/package/connectproxy/Config.in"
endmenu

menu "Coreboot"
	source "$BR2_EXTERNAL/package/coreboot/cbfstool/Config.in"
	source "$BR2_EXTERNAL/package/coreboot/ifdtool/Config.in"
	source "$BR2_EXTERNAL/package/coreboot/nvramtool/Config.in"
endmenu
```

## package/connectproxy/Config.in
```kconfig
config BR2_PACKAGE_CONNECTPROXY
	bool "connect-proxy"
	help
	  connect-proxy: Establish TCP connection using SOCKS4/5 or HTTP tunnel
	  
	  connect-proxy is a simple relaying command to make tunnel TCP connection
	  via SOCKS or HTTPS proxies.
	  It is mainly intended to be used as proxy command of OpenSSH.
	  
	  https://bitbucket.org/gotoh/connect/
```

## package/coreboot/cbfstool/Config.in
```kconfig
config BR2_PACKAGE_CBFSTOOL
	bool "cbfstool"
	depends on BR2_i386 || BR2_x86_64
#	depends on BR2_INSTALL_LIBSTDCPP
	help
      cbfstool is a utility for working with coreboot cbfs images.

	  http://www.coreboot.org/

#comment "cbfstool a needs toolchain w/ C++"
#    depends on !BR2_INSTALL_LIBSTDCPP
```

## package/coreboot/cbmem/Config.in
```kconfig
config BR2_PACKAGE_CBMEM
	bool "cbmem"
	depends on BR2_i386 || BR2_x86_64
	help
      cbmem is a tool for reading coreboot log dumps in memory

	  http://www.coreboot.org/
```

## package/coreboot/ifdtool/Config.in
```kconfig
config BR2_PACKAGE_IFDTOOL
	bool "ifdtool"
	depends on BR2_i386 || BR2_x86_64
	help
      ifdtool is a utility to inspect manipulate intel flash descriptor images.

	  http://www.coreboot.org/
```

## package/coreboot/intelmetool/Config.in
```kconfig
config BR2_PACKAGE_INTELMETOOL
	bool "intelmetool"
	help
	  intemetool: Tool to check the Intel ME configurations.
	  
	  https://github.com/zamaudio/intelmetool
```

## package/coreboot/nvramtool/Config.in
```kconfig
config BR2_PACKAGE_NVRAMTOOL
	bool "nvramtool"
	depends on BR2_i386 || BR2_x86_64
	help
      nvramtool is a utility for reading/writing coreboot parameters in NVRAM/CMOS
      and displaying information from the so-called 'coreboot table'.
      The coreboot table resides in low physical memory. It is created at
      boot time by coreboot, and contains various system information such as
      the type of mainboard in use. It specifies locations in the NVRAM/CMOS
      (nonvolatile RAM) where the coreboot parameters are stored.

	  http://www.coreboot.org/
```

## package/tlsdate/Config.in
```kconfig
config BR2_PACKAGE_TLSDATE
	bool "tlsdate"
	depends on BR2_PACKAGE_LIBEVENT
	depends on BR2_PACKAGE_OPENSSL
	help
	  tlsdate: secure parasitic rdate replacement
	  
	  tlsdate sets the local clock by securely connecting with TLS to remote
	  servers and extracting the remote time out of the secure handshake. Unlike
	  ntpdate, tlsdate uses TCP, for instance connecting to a remote HTTPS or TLS
	  enabled service, and provides some protection against adversaries that try to
	  feed you malicious time information.
	  
	  https://github.com/ioerror/tlsdate
```
